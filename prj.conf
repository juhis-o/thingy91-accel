## CMakeLists.txt
```
# SPDX-License-Identifier: Apache-2.0

cmake_minimum_required(VERSION 3.20.0)

find_package(Zephyr REQUIRED HINTS $ENV{ZEPHYR_BASE})
project(thingy_91_efficient_accel_measurement)

target_sources(app PRIVATE src/main.c src/msg_encode.c src/heatshrink_encoder.c src/modem.c src/networking.c src/shared.c src/sensor.c)
```

## Kconfig
```
#
# Copyright (c) 2019 Nordic Semiconductor ASA
#
# SPDX-License-Identifier: LicenseRef-Nordic-5-Clause
#

menu "nRF CoAP client sample"

config COAP_RESOURCE
	string "CoAP resource - defaults to Californium observable resource"
	default "obs"

config COAP_SERVER_HOSTNAME
	string "CoAP server hostname"
	default "californium.eclipseprojects.io"

config COAP_SERVER_PORT
	int "CoAP server port"
	default 5683
	
config COAP_SERVER_PSK
	string "Server psk"
	default "85d1ba99afe87dd73c46b144d165acd7d282e427796ae2794ad089b7aece51b5"

config COAP_DEVICE_NAME
	string "Device resource name - this will be the device name on the CoAP server"
	default "Client"


endmenu

menu "UDP Sample Settings"

config UDP_DATA_UPLOAD_SIZE_BYTES
	int "Number of bytes transmitted to the server"
	default 10

config UDP_DATA_UPLOAD_FREQUENCY_SECONDS
	int "How often data is transmitted to the server"
	default 900

config UDP_SERVER_ADDRESS_STATIC
	string "UDP server IP address"
	default "8.8.8.8"

config UDP_SERVER_PORT
	int "UDP server port number"
	default "2469"

config UDP_PSM_ENABLE
	bool "Enable LTE Power Saving Mode"
	default y

config UDP_EDRX_ENABLE
	bool "Enable LTE enhanced Discontinuous Reception"

config UDP_RAI_ENABLE
	bool "Enable LTE Release Assistance Indication"

endmenu



menu "Zephyr Kernel"
source "Kconfig.zephyr"
endmenu
```

## west.yml
```
manifest:
  remotes:
    - name: ncs
      url-base: https://github.com/nrfconnect
  projects:
    - name: sdk-nrf
      remote: ncs
      path: nrf
      revision: v2.1.3
      import: true
      clone-depth: 1
  self:
    path: acceleration
```

## prj.conf
```kconfig
# Networking
CONFIG_NETWORKING=y
CONFIG_NET_NATIVE=n
CONFIG_NET_SOCKETS_OFFLOAD=y
CONFIG_NET_SOCKETS=y
CONFIG_NET_SOCKETS_POSIX_NAMES=y

## PSM
CONFIG_UDP_PSM_ENABLE=y
CONFIG_LTE_PSM_REQ_RPTAU="00100001"
CONFIG_LTE_PSM_REQ_RAT="00000000"
CONFIG_LTE_EDRX_REQ_VALUE_LTE_M="0010" #4-bittinen formaatti 
CONFIG_LTE_PTW_VALUE_LTE_M="0000" #4-bittinen formaatti

## eDRX
CONFIG_UDP_EDRX_ENABLE=y
#CONFIG_LTE_EDRX_REQ_VALUE_LTE_M="1001"

## RAI
CONFIG_UDP_RAI_ENABLE=n
CONFIG_LTE_RAI_REQ_VALUE="4"

# LTE link control
CONFIG_LTE_LINK_CONTROL=y
#CONFIG_LTE_AUTO_INIT_AND_CONNECT=n

# Modem library
CONFIG_NRF_MODEM_LIB=y
CONFIG_MODEM_KEY_MGMT=y
#CONFIG_NRF_MODEM_LIB_TRACE=n

# AT Host
#CONFIG_UART_INTERRUPT_DRIVEN=n

# CoAP
CONFIG_COAP=y
CONFIG_COAP_SERVER_HOSTNAME="87.100.195.67"
CONFIG_COAP_RESOURCE="cbor"
CONFIG_COAP_SERVER_PORT=5684
CONFIG_COAP_DEVICE_NAME="client"

# Main thread
#CONFIG_MAIN_STACK_SIZE=4096
CONFIG_MAIN_STACK_SIZE=8192
CONFIG_SYSTEM_WORKQUEUE_STACK_SIZE=8192

# General config
CONFIG_HEAP_MEM_POOL_SIZE=8192
#CONFIG_NEWLIB_LIBC=n

#Sensors
CONFIG_SPI=y
CONFIG_SENSOR=y
CONFIG_ADXL362_TRIGGER_GLOBAL_THREAD=y
CONFIG_ADXL362_INTERRUPT_MODE=3
CONFIG_ADXL362_ABS_REF_MODE=0
CONFIG_ADXL362_ACCEL_ODR_12_5=y
#CONFIG_SENSOR_LOG_LEVEL_INF=y
#CONFIG_ADX362_TRIGGER=y

#Prints
#CONFIG_CBPRINTF_FP_SUPPORT=y
#CONFIG_NEWLIB_LIBC=y
#CONFIG_NEWLIB_LIBC_FLOAT_PRINTF=y

CONFIG_LOG=y
CONFIG_SERIAL=y
CONFIG_UART_CONSOLE=y
CONFIG_AT_HOST_LIBRARY=n
#CONFIG_TFM_LOG_LEVEL_SILENCE=n


#ZCBOR
CONFIG_ZCBOR=y
CONFIG_ZCBOR_CANONICAL=y
#CONFIG_ZCBOR_VERBOSE=y

#CONFIG_SENSOR_LOG_LEVEL_DBG=y
#CONFIG_MODEM_KEY_MGMT_LOG_LEVEL_DBG=n

#CONFIG_FLASH=y
#CONFIG_FLASH_MAP=y
#CONFIG_FLASH_PAGE_LAYOUT=y

#CONFIG_FILE_SYSTEM=y
#CONFIG_FILE_SYSTEM_LITTLEFS=y
```

## src/main.c
```c
#include <stdio.h>
#include "networking.h"
#include "main.h"
#include "modem.h"
#include "sensor.h"
#include "shared.h"

#define WORKQ_STACK 4096

LOG_MODULE_REGISTER(MAIN,4);

K_THREAD_STACK_DEFINE(networking_stack, WORKQ_STACK);
struct k_work_q networking_work_q = {0};
struct k_work empty_fifo;
struct k_work coap_send;

extern bool send_flag;
extern uint8_t msg_index;

int main(void){
	int err = 0;
	send_flag = false;
	msg_index = 0;

	err = initialize_sensors();
	if (err < 0) {
		LOG_ERR("Failed to initialize sensors\n");
		return -1;
	}
	err = initialize_modem();
	if (err < 0) {
		LOG_ERR("Failed to initialize modem\n");
		return -1;
	}
	err = connect_to_server();
	if (err < 0) {
		LOG_ERR("Failed to connect\n");
		return -1;
	}

	k_work_init(&coap_send, coap_send_fn);
	
	k_work_queue_start(&networking_work_q, networking_stack,
                   K_THREAD_STACK_SIZEOF(networking_stack), 4,
                   NULL);

	k_work_init(&empty_fifo, empty_fifo_fn);
	
	return 0;
}
```

## src/heatshrink_encoder.c
```c
#include <stdlib.h>
#include <string.h>
#include <stdbool.h>
#include "heatshrink_encoder.h"

typedef enum {
    HSES_NOT_FULL,              /* input buffer not full enough */
    HSES_FILLED,                /* buffer is full */
    HSES_SEARCH,                /* searching for patterns */
    HSES_YIELD_TAG_BIT,         /* yield tag bit */
    HSES_YIELD_LITERAL,         /* emit literal byte */
    HSES_YIELD_BR_INDEX,        /* yielding backref index */
    HSES_YIELD_BR_LENGTH,       /* yielding backref length */
    HSES_SAVE_BACKLOG,          /* copying buffer to backlog */
    HSES_FLUSH_BITS,            /* flush bit buffer */
    HSES_DONE,                  /* done */
} HSE_state;

#if HEATSHRINK_DEBUGGING_LOGS
#include <stdio.h>
#include <ctype.h>
#include <assert.h>
#define LOG(...) fprintf(stderr, __VA_ARGS__)
#define ASSERT(X) assert(X)
static const char *state_names[] = {
    "not_full",
    "filled",
    "search",
    "yield_tag_bit",
    "yield_literal",
    "yield_br_index",
    "yield_br_length",
    "save_backlog",
    "flush_bits",
    "done",
};
#else
#define LOG(...) /* no-op */
#define ASSERT(X) /* no-op */
#endif

// Encoder flags
enum {
    FLAG_IS_FINISHING = 0x01,
};

typedef struct {
    uint8_t *buf;               /* output buffer */
    size_t buf_size;            /* buffer size */
    size_t *output_size;        /* bytes pushed to buffer, so far */
} output_info;

#define MATCH_NOT_FOUND ((uint16_t)-1)

static uint16_t get_input_offset(heatshrink_encoder *hse);
static uint16_t get_input_buffer_size(heatshrink_encoder *hse);
static uint16_t get_lookahead_size(heatshrink_encoder *hse);
static void add_tag_bit(heatshrink_encoder *hse, output_info *oi, uint8_t tag);
static int can_take_byte(output_info *oi);
static int is_finishing(heatshrink_encoder *hse);
static void save_backlog(heatshrink_encoder *hse);

/* Push COUNT (max 8) bits to the output buffer, which has room. */
static void push_bits(heatshrink_encoder *hse, uint8_t count, uint8_t bits,
    output_info *oi);
static uint8_t push_outgoing_bits(heatshrink_encoder *hse, output_info *oi);
static void push_literal_byte(heatshrink_encoder *hse, output_info *oi);

#if HEATSHRINK_DYNAMIC_ALLOC
heatshrink_encoder *heatshrink_encoder_alloc(uint8_t window_sz2,
        uint8_t lookahead_sz2) {
    if ((window_sz2 < HEATSHRINK_MIN_WINDOW_BITS) ||
        (window_sz2 > HEATSHRINK_MAX_WINDOW_BITS) ||
        (lookahead_sz2 < HEATSHRINK_MIN_LOOKAHEAD_BITS) ||
        (lookahead_sz2 >= window_sz2)) {
        return NULL;
    }
    
    /* Note: 2 * the window size is used because the buffer needs to fit
     * (1 << window_sz2) bytes for the current input, and an additional
     * (1 << window_sz2) bytes for the previous buffer of input, which
     * will be scanned for useful backreferences. */
    size_t buf_sz = (2 << window_sz2);

    heatshrink_encoder *hse = HEATSHRINK_MALLOC(sizeof(*hse) + buf_sz);
    if (hse == NULL) { return NULL; }
    hse->window_sz2 = window_sz2;
    hse->lookahead_sz2 = lookahead_sz2;
    heatshrink_encoder_reset(hse);

#if HEATSHRINK_USE_INDEX
    size_t index_sz = buf_sz*sizeof(uint16_t);
    hse->search_index = HEATSHRINK_MALLOC(index_sz + sizeof(struct hs_index));
    if (hse->search_index == NULL) {
        HEATSHRINK_FREE(hse, sizeof(*hse) + buf_sz);
        return NULL;
    }
    hse->search_index->size = index_sz;
#endif

    LOG("-- allocated encoder with buffer size of %zu (%u byte input size)\n",
        buf_sz, get_input_buffer_size(hse));
    //printk("Size of HSE : %zu, %u",buf_sz,get_input_buffer_size(hse) );
    return hse;
}

void heatshrink_encoder_free(heatshrink_encoder *hse) {
    size_t buf_sz = (2 << HEATSHRINK_ENCODER_WINDOW_BITS(hse));
#if HEATSHRINK_USE_INDEX
    size_t index_sz = sizeof(struct hs_index) + hse->search_index->size;
    HEATSHRINK_FREE(hse->search_index, index_sz);
    (void)index_sz;
#endif
    HEATSHRINK_FREE(hse, sizeof(heatshrink_encoder) + buf_sz);
    (void)buf_sz;
}
#endif

void heatshrink_encoder_reset(heatshrink_encoder *hse) {
    size_t buf_sz = (2 << HEATSHRINK_ENCODER_WINDOW_BITS(hse));
    memset(hse->buffer, 0, buf_sz);
    hse->input_size = 0;
    hse->state = HSES_NOT_FULL;
    hse->match_scan_index = 0;
    hse->flags = 0;
    hse->bit_index = 0x80;
    hse->current_byte = 0x00;
    hse->match_length = 0;

    hse->outgoing_bits = 0x0000;
    hse->outgoing_bits_count = 0;

    #ifdef LOOP_DETECT
    hse->loop_detect = (uint32_t)-1;
    #endif
}

HSE_sink_res heatshrink_encoder_sink(heatshrink_encoder *hse,
        uint8_t *in_buf, size_t size, size_t *input_size) {
    if ((hse == NULL) || (in_buf == NULL) || (input_size == NULL)) {
        return HSER_SINK_ERROR_NULL;
    }

    /* Sinking more content after saying the content is done, tsk tsk */
    if (is_finishing(hse)) { return HSER_SINK_ERROR_MISUSE; }

    /* Sinking more content before processing is done */
    if (hse->state != HSES_NOT_FULL) { return HSER_SINK_ERROR_MISUSE; }

    uint16_t write_offset = get_input_offset(hse) + hse->input_size;
    uint16_t ibs = get_input_buffer_size(hse);
    uint16_t rem = ibs - hse->input_size;
    uint16_t cp_sz = rem < size ? rem : size;

    memcpy(&hse->buffer[write_offset], in_buf, cp_sz);
    *input_size = cp_sz;
    hse->input_size += cp_sz;

    LOG("-- sunk %u bytes (of %zu) into encoder at %d, input buffer now has %u\n",
        cp_sz, size, write_offset, hse->input_size);
    if (cp_sz == rem) {
        LOG("-- internal buffer is now full\n");
        hse->state = HSES_FILLED;
    }

    return HSER_SINK_OK;
}


/***************
 * Compression *
 ***************/

static uint16_t find_longest_match(heatshrink_encoder *hse, uint16_t start,
    uint16_t end, const uint16_t maxlen, uint16_t *match_length);
static void do_indexing(heatshrink_encoder *hse);

static HSE_state st_step_search(heatshrink_encoder *hse);
static HSE_state st_yield_tag_bit(heatshrink_encoder *hse,
    output_info *oi);
static HSE_state st_yield_literal(heatshrink_encoder *hse,
    output_info *oi);
static HSE_state st_yield_br_index(heatshrink_encoder *hse,
    output_info *oi);
static HSE_state st_yield_br_length(heatshrink_encoder *hse,
    output_info *oi);
static HSE_state st_save_backlog(heatshrink_encoder *hse);
static HSE_state st_flush_bit_buffer(heatshrink_encoder *hse,
    output_info *oi);

HSE_poll_res heatshrink_encoder_poll(heatshrink_encoder *hse,
        uint8_t *out_buf, size_t out_buf_size, size_t *output_size) {
    if ((hse == NULL) || (out_buf == NULL) || (output_size == NULL)) {
        return HSER_POLL_ERROR_NULL;
    }
    if (out_buf_size == 0) {
        LOG("-- MISUSE: output buffer size is 0\n");
        return HSER_POLL_ERROR_MISUSE;
    }
    *output_size = 0;

    output_info oi;
    oi.buf = out_buf;
    oi.buf_size = out_buf_size;
    oi.output_size = output_size;

    while (1) {
        LOG("-- polling, state %u (%s), flags 0x%02x\n",
            hse->state, state_names[hse->state], hse->flags);

        uint8_t in_state = hse->state;
        switch (in_state) {
        case HSES_NOT_FULL:
            return HSER_POLL_EMPTY;
        case HSES_FILLED:
            do_indexing(hse);
            hse->state = HSES_SEARCH;
            break;
        case HSES_SEARCH:
            hse->state = st_step_search(hse);
            break;
        case HSES_YIELD_TAG_BIT:
            hse->state = st_yield_tag_bit(hse, &oi);
            break;
        case HSES_YIELD_LITERAL:
            hse->state = st_yield_literal(hse, &oi);
            break;
        case HSES_YIELD_BR_INDEX:
            hse->state = st_yield_br_index(hse, &oi);
            break;
        case HSES_YIELD_BR_LENGTH:
            hse->state = st_yield_br_length(hse, &oi);
            break;
        case HSES_SAVE_BACKLOG:
            hse->state = st_save_backlog(hse);
            break;
        case HSES_FLUSH_BITS:
            hse->state = st_flush_bit_buffer(hse, &oi);
        case HSES_DONE:
            return HSER_POLL_EMPTY;
        default:
            LOG("-- bad state %s\n", state_names[hse->state]);
            return HSER_POLL_ERROR_MISUSE;
        }

        if (hse->state == in_state) {
            /* Check if output buffer is exhausted. */
            if (*output_size == out_buf_size) return HSER_POLL_MORE;
        }
    }
}

HSE_finish_res heatshrink_encoder_finish(heatshrink_encoder *hse) {
    if (hse == NULL) { return HSER_FINISH_ERROR_NULL; }
    LOG("-- setting is_finishing flag\n");
    hse->flags |= FLAG_IS_FINISHING;
    if (hse->state == HSES_NOT_FULL) { hse->state = HSES_FILLED; }
    return hse->state == HSES_DONE ? HSER_FINISH_DONE : HSER_FINISH_MORE;
}

static HSE_state st_step_search(heatshrink_encoder *hse) {
    uint16_t window_length = get_input_buffer_size(hse);
    uint16_t lookahead_sz = get_lookahead_size(hse);
    uint16_t msi = hse->match_scan_index;
    LOG("## step_search, scan @ +%d (%d/%d), input size %d\n",
        msi, hse->input_size + msi, 2*window_length, hse->input_size);

    bool fin = is_finishing(hse);
    if (msi > hse->input_size - (fin ? 1 : lookahead_sz)) {
        /* Current search buffer is exhausted, copy it into the
         * backlog and await more input. */
        LOG("-- end of search @ %d\n", msi);
        return fin ? HSES_FLUSH_BITS : HSES_SAVE_BACKLOG;
    }

    uint16_t input_offset = get_input_offset(hse);
    uint16_t end = input_offset + msi;
    uint16_t start = end - window_length;

    uint16_t max_possible = lookahead_sz;
    if (hse->input_size - msi < lookahead_sz) {
        max_possible = hse->input_size - msi;
    }
    
    uint16_t match_length = 0;
    uint16_t match_pos = find_longest_match(hse,
        start, end, max_possible, &match_length);
    
    if (match_pos == MATCH_NOT_FOUND) {
        LOG("ss Match not found\n");
        hse->match_scan_index++;
        hse->match_length = 0;
        return HSES_YIELD_TAG_BIT;
    } else {
        LOG("ss Found match of %d bytes at %d\n", match_length, match_pos);
        hse->match_pos = match_pos;
        hse->match_length = match_length;
        ASSERT(match_pos <= 1 << HEATSHRINK_ENCODER_WINDOW_BITS(hse) /*window_length*/);

        return HSES_YIELD_TAG_BIT;
    }
}

static HSE_state st_yield_tag_bit(heatshrink_encoder *hse,
        output_info *oi) {
    if (can_take_byte(oi)) {
        if (hse->match_length == 0) {
            add_tag_bit(hse, oi, HEATSHRINK_LITERAL_MARKER);
            return HSES_YIELD_LITERAL;
        } else {
            add_tag_bit(hse, oi, HEATSHRINK_BACKREF_MARKER);
            hse->outgoing_bits = hse->match_pos - 1;
            hse->outgoing_bits_count = HEATSHRINK_ENCODER_WINDOW_BITS(hse);
            return HSES_YIELD_BR_INDEX;
        }
    } else {
        return HSES_YIELD_TAG_BIT; /* output is full, continue */
    }
}

static HSE_state st_yield_literal(heatshrink_encoder *hse,
        output_info *oi) {
    if (can_take_byte(oi)) {
        push_literal_byte(hse, oi);
        return HSES_SEARCH;
    } else {
        return HSES_YIELD_LITERAL;
    }
}

static HSE_state st_yield_br_index(heatshrink_encoder *hse,
        output_info *oi) {
    if (can_take_byte(oi)) {
        LOG("-- yielding backref index %u\n", hse->match_pos);
        if (push_outgoing_bits(hse, oi) > 0) {
            return HSES_YIELD_BR_INDEX; /* continue */
        } else {
            hse->outgoing_bits = hse->match_length - 1;
            hse->outgoing_bits_count = HEATSHRINK_ENCODER_LOOKAHEAD_BITS(hse);
            return HSES_YIELD_BR_LENGTH; /* done */
        }
    } else {
        return HSES_YIELD_BR_INDEX; /* continue */
    }
}

static HSE_state st_yield_br_length(heatshrink_encoder *hse,
        output_info *oi) {
    if (can_take_byte(oi)) {
        LOG("-- yielding backref length %u\n", hse->match_length);
        if (push_outgoing_bits(hse, oi) > 0) {
            return HSES_YIELD_BR_LENGTH;
        } else {
            hse->match_scan_index += hse->match_length;
            hse->match_length = 0;
            return HSES_SEARCH;
        }
    } else {
        return HSES_YIELD_BR_LENGTH;
    }
}

static HSE_state st_save_backlog(heatshrink_encoder *hse) {
    LOG("-- saving backlog\n");
    save_backlog(hse);
    return HSES_NOT_FULL;
}

static HSE_state st_flush_bit_buffer(heatshrink_encoder *hse,
        output_info *oi) {
    if (hse->bit_index == 0x80) {
        LOG("-- done!\n");
        return HSES_DONE;
    } else if (can_take_byte(oi)) {
        LOG("-- flushing remaining byte (bit_index == 0x%02x)\n", hse->bit_index);
        oi->buf[(*oi->output_size)++] = hse->current_byte;
        LOG("-- done!\n");
        return HSES_DONE;
    } else {
        return HSES_FLUSH_BITS;
    }
}

static void add_tag_bit(heatshrink_encoder *hse, output_info *oi, uint8_t tag) {
    LOG("-- adding tag bit: %d\n", tag);
    push_bits(hse, 1, tag, oi);
}

static uint16_t get_input_offset(heatshrink_encoder *hse) {
    return get_input_buffer_size(hse);
}

static uint16_t get_input_buffer_size(heatshrink_encoder *hse) {
    return (1 << HEATSHRINK_ENCODER_WINDOW_BITS(hse));
    (void)hse;
}

static uint16_t get_lookahead_size(heatshrink_encoder *hse) {
    return (1 << HEATSHRINK_ENCODER_LOOKAHEAD_BITS(hse));
    (void)hse;
}

static void do_indexing(heatshrink_encoder *hse) {
#if HEATSHRINK_USE_INDEX
    /* Build an index array I that contains flattened linked lists
     * for the previous instances of every byte in the buffer.
     * 
     * For example, if buf[200] == 'x', then index[200] will either
     * be an offset i such that buf[i] == 'x', or a negative offset
     * to indicate end-of-list. This significantly speeds up matching,
     * while only using sizeof(uint16_t)*sizeof(buffer) bytes of RAM.
     *
     * Future optimization options:
     * 1. Since any negative value represents end-of-list, the other
     *    15 bits could be used to improve the index dynamically.
     *    
     * 2. Likewise, the last lookahead_sz bytes of the index will
     *    not be usable, so temporary data could be stored there to
     *    dynamically improve the index.
     * */
    struct hs_index *hsi = HEATSHRINK_ENCODER_INDEX(hse);
    int16_t last[256];
    memset(last, 0xFF, sizeof(last));

    uint8_t * const data = hse->buffer;
    int16_t * const index = hsi->index;

    const uint16_t input_offset = get_input_offset(hse);
    const uint16_t end = input_offset + hse->input_size;

    for (uint16_t i=0; i<end; i++) {
        uint8_t v = data[i];
        int16_t lv = last[v];
        index[i] = lv;
        last[v] = i;
    }
#else
    (void)hse;
#endif
}

static int is_finishing(heatshrink_encoder *hse) {
    return hse->flags & FLAG_IS_FINISHING;
}

static int can_take_byte(output_info *oi) {
    return *oi->output_size < oi->buf_size;
}

/* Return the longest match for the bytes at buf[end:end+maxlen] between
 * buf[start] and buf[end-1]. If no match is found, return -1. */
static uint16_t find_longest_match(heatshrink_encoder *hse, uint16_t start,
        uint16_t end, const uint16_t maxlen, uint16_t *match_length) {
    LOG("-- scanning for match of buf[%u:%u] between buf[%u:%u] (max %u bytes)\n",
        end, end + maxlen, start, end + maxlen - 1, maxlen);
    uint8_t *buf = hse->buffer;

    uint16_t match_maxlen = 0;
    uint16_t match_index = MATCH_NOT_FOUND;

    uint16_t len = 0;
    uint8_t * const needlepoint = &buf[end];
#if HEATSHRINK_USE_INDEX
    struct hs_index *hsi = HEATSHRINK_ENCODER_INDEX(hse);
    int16_t pos = hsi->index[end];

    while (pos - (int16_t)start >= 0) {
        uint8_t * const pospoint = &buf[pos];
        len = 0;

        /* Only check matches that will potentially beat the current maxlen.
         * This is redundant with the index if match_maxlen is 0, but the
         * added branch overhead to check if it == 0 seems to be worse. */
        if (pospoint[match_maxlen] != needlepoint[match_maxlen]) {
            pos = hsi->index[pos];
            continue;
        }

        for (len = 1; len < maxlen; len++) {
            if (pospoint[len] != needlepoint[len]) break;
        }

        if (len > match_maxlen) {
            match_maxlen = len;
            match_index = pos;
            if (len == maxlen) { break; } /* won't find better */
        }
        pos = hsi->index[pos];
    }
#else    
    for (int16_t pos=end - 1; pos - (int16_t)start >= 0; pos--) {
        uint8_t * const pospoint = &buf[pos];
        if ((pospoint[match_maxlen] == needlepoint[match_maxlen])
            && (*pospoint == *needlepoint)) {
            for (len=1; len<maxlen; len++) {
                if (0) {
                    LOG("  --> cmp buf[%d] == 0x%02x against %02x (start %u)\n",
                        pos + len, pospoint[len], needlepoint[len], start);
                }
                if (pospoint[len] != needlepoint[len]) { break; }
            }
            if (len > match_maxlen) {
                match_maxlen = len;
                match_index = pos;
                if (len == maxlen) { break; } /* don't keep searching */
            }
        }
    }
#endif
    
    const size_t break_even_point =
      (1 + HEATSHRINK_ENCODER_WINDOW_BITS(hse) +
          HEATSHRINK_ENCODER_LOOKAHEAD_BITS(hse));

    /* Instead of comparing break_even_point against 8*match_maxlen,
     * compare match_maxlen against break_even_point/8 to avoid
     * overflow. Since MIN_WINDOW_BITS and MIN_LOOKAHEAD_BITS are 4 and
     * 3, respectively, break_even_point/8 will always be at least 1. */
    if (match_maxlen > (break_even_point / 8)) {
        LOG("-- best match: %u bytes at -%u\n",
            match_maxlen, end - match_index);
        *match_length = match_maxlen;
        return end - match_index;
    }
    LOG("-- none found\n");
    return MATCH_NOT_FOUND;
}

static uint8_t push_outgoing_bits(heatshrink_encoder *hse, output_info *oi) {
    uint8_t count = 0;
    uint8_t bits = 0;
    if (hse->outgoing_bits_count > 8) {
        count = 8;
        bits = hse->outgoing_bits >> (hse->outgoing_bits_count - 8);
    } else {
        count = hse->outgoing_bits_count;
        bits = hse->outgoing_bits;
    }

    if (count > 0) {
        LOG("-- pushing %d outgoing bits: 0x%02x\n", count, bits);
        push_bits(hse, count, bits, oi);
        hse->outgoing_bits_count -= count;
    }
    return count;
}

/* Push COUNT (max 8) bits to the output buffer, which has room.
 * Bytes are set from the lowest bits, up. */
static void push_bits(heatshrink_encoder *hse, uint8_t count, uint8_t bits,
        output_info *oi) {
    ASSERT(count <= 8);
    LOG("++ push_bits: %d bits, input of 0x%02x\n", count, bits);

    /* If adding a whole byte and at the start of a new output byte,
     * just push it through whole and skip the bit IO loop. */
    if (count == 8 && hse->bit_index == 0x80) {
        oi->buf[(*oi->output_size)++] = bits;
    } else {
        for (int i=count - 1; i>=0; i--) {
            bool bit = bits & (1 << i);
            if (bit) { hse->current_byte |= hse->bit_index; }
            if (0) {
                LOG("  -- setting bit %d at bit index 0x%02x, byte => 0x%02x\n",
                    bit ? 1 : 0, hse->bit_index, hse->current_byte);
            }
            hse->bit_index >>= 1;
            if (hse->bit_index == 0x00) {
                hse->bit_index = 0x80;
                LOG(" > pushing byte 0x%02x\n", hse->current_byte);
                oi->buf[(*oi->output_size)++] = hse->current_byte;
                hse->current_byte = 0x00;
            }
        }
    }
}

static void push_literal_byte(heatshrink_encoder *hse, output_info *oi) {
    uint16_t processed_offset = hse->match_scan_index - 1;
    uint16_t input_offset = get_input_offset(hse) + processed_offset;
    uint8_t c = hse->buffer[input_offset];
    LOG("-- yielded literal byte 0x%02x ('%c') from +%d\n",
        c, isprint(c) ? c : '.', input_offset);
    push_bits(hse, 8, c, oi);
}

static void save_backlog(heatshrink_encoder *hse) {
    size_t input_buf_sz = get_input_buffer_size(hse);
    
    uint16_t msi = hse->match_scan_index;
    
    /* Copy processed data to beginning of buffer, so it can be
     * used for future matches. Don't bother checking whether the
     * input is less than the maximum size, because if it isn't,
     * we're done anyway. */
    uint16_t rem = input_buf_sz - msi; // unprocessed bytes
    uint16_t shift_sz = input_buf_sz + rem;

    memmove(&hse->buffer[0],
        &hse->buffer[input_buf_sz - rem],
        shift_sz);
        
    hse->match_scan_index = 0;
    hse->input_size -= input_buf_sz - rem;
}
```

## src/main.h
```c
#include "heatshrink_encoder.h"
#include "msg_encode.h"
#include "zcbor_common.h"

#define COAP_TIMEOUT 3000
#define COAP_MSG_MAX_LEN 1280
#define APP_COAP_VERSION 1
#define SEC_TAG 123
#define FIFO_SIZE 510
#define PAYLOAD_SIZE 1024
#define PAYLOAD_COUNT 60
#define ARRAY_BYTE 1
#define TABLE_BYTES 2
#define POLL_IN 0
#define POLL_OUT 1
#define WORKQ_STACK 4096

static int wait(int timeout, bool status);
static void coap_send_fn(struct k_work * work);
static void empty_fifo_fn(struct k_work *work);
static int server_resolve(void);
static int client_init(void);
static int client_handle_get_response(uint8_t *buf, int received,uint8_t *pload);
static int client_get_send(uint8_t * payload, uint16_t payloadSize, bool msg_type, uint16_t token);
static int modem_configure(void);
static void lte_handler(const struct lte_lc_evt *const evt);
static int configure_low_power(void);
static bool check_list(uint16_t x, uint8_t msg_index);

union received_msg {
  uint16_t integer;
  uint8_t bytes[2];
};

struct message_payload {
	uint16_t size;
	uint8_t payload[1100];
};
```

## src/modem.c
```c
#include "modem.h"
#include <zephyr/logging/log.h>

LOG_MODULE_REGISTER(MODEM,4);

K_SEM_DEFINE(lte_connected, 0, 1);

int initialize_modem(void){
    int err = 0;

	err = modem_configure();
	if(err) {
		LOG_ERR("Unable to configure modem, error: %d\n",
		       err);
	}

	err = configure_low_power();
	if(err) {
		LOG_ERR("Unable to set low power configuration, error: %d\n",
		       err);
	}

    return err;
}

void lte_handler(const struct lte_lc_evt *const evt) {
	switch (evt->type) {
	case LTE_LC_EVT_NW_REG_STATUS:
		if ((evt->nw_reg_status != LTE_LC_NW_REG_REGISTERED_HOME) &&
		     (evt->nw_reg_status != LTE_LC_NW_REG_REGISTERED_ROAMING)) {
			break;
		}
		LOG_INF("Network registration status: %s\n",
			evt->nw_reg_status == LTE_LC_NW_REG_REGISTERED_HOME ?
			"Connected - home network" : "Connected - roaming\n");
		k_sem_give(&lte_connected);
		break;
	case LTE_LC_EVT_PSM_UPDATE:
		LOG_INF("PSM parameter update: TAU: %d, Active time: %d\n",
			evt->psm_cfg.tau, evt->psm_cfg.active_time);
		break;
	case LTE_LC_EVT_EDRX_UPDATE: {
		char log_buf[60];
		ssize_t len;
		len = snprintf(log_buf, sizeof(log_buf),
			       "eDRX parameter update: eDRX: %f, PTW: %f\n",
			       evt->edrx_cfg.edrx, evt->edrx_cfg.ptw);
		if (len > 0) {
			LOG_INF("%s\n", log_buf);
		}
		break;
	}
	case LTE_LC_EVT_RRC_UPDATE:
		LOG_INF("RRC mode: %s\n",
			evt->rrc_mode == LTE_LC_RRC_MODE_CONNECTED ?
			"Connected" : "Idle\n");
		break;
	case LTE_LC_EVT_CELL_UPDATE:
		LOG_INF("LTE cell changed: Cell ID: %d, Tracking area: %d\n",
		       evt->cell.id, evt->cell.tac);
		break;
	default:
		break;
	}
}

int modem_configure(void) {
	int err;

	LOG_INF("Initializing modem library");
	err = nrf_modem_lib_init();
	if (err) {
		LOG_ERR("Failed to initialize the modem library, error: %d", err);
		return err;
	}

	LOG_INF("Connecting to LTE network");
	err = lte_lc_connect_async(lte_handler);
	if (err) {
		LOG_ERR("Error in lte_lc_connect_async, error: %d", err);
		return err;
	}

	k_sem_take(&lte_connected, K_FOREVER);
	LOG_INF("Connected to LTE network");

	return 0;
}

int configure_low_power(void) {
	int err;

#if defined(CONFIG_UDP_PSM_ENABLE)
	/** Power Saving Mode */
	err = lte_lc_psm_req(true);
	if (err) {
		LOG_ERR("lte_lc_psm_req, error: %d\n", err);
	}
#else
	err = lte_lc_psm_req(false);
	if (err) {
		LOG_ERR("lte_lc_psm_req, error: %d\n", err);
	}
#endif

#if defined(CONFIG_UDP_EDRX_ENABLE)
	/** enhanced Discontinuous Reception */
	err = lte_lc_edrx_req(true);
	if (err) {
		LOG_ERR("lte_lc_edrx_req, error: %d\n", err);
	}
#else
	err = lte_lc_edrx_req(false);
	if (err) {
		LOG_ERR("lte_lc_edrx_req, error: %d\n", err);
	}
#endif

#if defined(CONFIG_UDP_RAI_ENABLE)
	/** Release Assistance Indication  */
	err = lte_lc_rai_req(true);
	if (err) {
		LOG_ERR("lte_lc_rai_req, error: %d\n", err);
	}
#endif

	return err;
}
```

## src/modem.h
```c
#ifndef MODEM_H
#define MODEM_H

#include <modem/modem_key_mgmt.h>
#include <modem/nrf_modem_lib.h>
#include <modem/lte_lc.h>

int modem_configure(void);
void lte_handler(const struct lte_lc_evt *const evt);
int configure_low_power(void);
int initialize_modem(void);

#endif //MODEM_H
```

## src/msg_encode.c
```c
/*
 * Generated using zcbor version 0.8.1
 * https://github.com/NordicSemiconductor/zcbor
 * Generated with a --default-max-qty of 256
 */

#include <stdint.h>
#include <stdbool.h>
#include <stddef.h>
#include <string.h>
#include "zcbor_encode.h"
#include "msg_encode.h"
#include "zcbor_print.h"

#if DEFAULT_MAX_QTY != 256
#error "The type file was generated with a different default_max_qty than this file"
#endif

static bool encode_repeated_msg_xyz(zcbor_state_t *state, const struct msg_xyz *input);
static bool encode_msg(zcbor_state_t *state, const struct msg *input);


static bool encode_repeated_msg_xyz(
		zcbor_state_t *state, const struct msg_xyz *input)
{
	zcbor_log("%s\r\n", __func__);

	bool tmp_result = (((zcbor_list_start_encode(state, 3) && (((((((*input).msg_xyz_x >= INT16_MIN)
	&& ((*input).msg_xyz_x <= INT16_MAX)) || (zcbor_error(state, ZCBOR_ERR_WRONG_RANGE), false))
	&& (zcbor_int32_encode(state, (&(*input).msg_xyz_x))))
	&& (((((*input).msg_xyz_y >= INT16_MIN)
	&& ((*input).msg_xyz_y <= INT16_MAX)) || (zcbor_error(state, ZCBOR_ERR_WRONG_RANGE), false))
	&& (zcbor_int32_encode(state, (&(*input).msg_xyz_y))))
	&& (((((*input).msg_xyz_z >= INT16_MIN)
	&& ((*input).msg_xyz_z <= INT16_MAX)) || (zcbor_error(state, ZCBOR_ERR_WRONG_RANGE), false))
	&& (zcbor_int32_encode(state, (&(*input).msg_xyz_z))))) || (zcbor_list_map_end_force_encode(state), false)) && zcbor_list_end_encode(state, 3))));

	if (!tmp_result) {
		zcbor_trace_file(state);
		zcbor_log("%s error: %s\r\n", __func__, zcbor_error_str(zcbor_peek_error(state)));
	} else {
		zcbor_log("%s success\r\n", __func__);
	}

	return tmp_result;
}

static bool encode_msg(
		zcbor_state_t *state, const struct msg *input)
{
	zcbor_log("%s\r\n", __func__);

	bool tmp_result = (((zcbor_list_start_encode(state, 257) && ((((zcbor_list_start_encode(state, 4) && (((((((*input).msg_tphg_timestamp <= UINT64_MAX)) || (zcbor_error(state, ZCBOR_ERR_WRONG_RANGE), false))
	&& (zcbor_uint64_encode(state, (&(*input).msg_tphg_timestamp))))
	&& ((zcbor_int32_encode(state, (&(*input).msg_tphg_temp))))
	&& ((zcbor_int32_encode(state, (&(*input).msg_tphg_press))))
	&& ((zcbor_int32_encode(state, (&(*input).msg_tphg_hum))))) || (zcbor_list_map_end_force_encode(state), false)) && zcbor_list_end_encode(state, 4)))
	&& zcbor_multi_encode_minmax(1, 256, &(*input).msg_xyz_count, (zcbor_encoder_t *)encode_repeated_msg_xyz, state, (&(*input).msg_xyz), sizeof(struct msg_xyz))) || (zcbor_list_map_end_force_encode(state), false)) && zcbor_list_end_encode(state, 257))));

	if (!tmp_result) {
		zcbor_trace_file(state);
		zcbor_log("%s error: %s\r\n", __func__, zcbor_error_str(zcbor_peek_error(state)));
	} else {
		zcbor_log("%s success\r\n", __func__);
	}

	return tmp_result;
}



int cbor_encode_msg(
		uint8_t *payload, size_t payload_len,
		const struct msg *input,
		size_t *payload_len_out)
{
	zcbor_state_t states[4];

	return zcbor_entry_function(payload, payload_len, (void *)input, payload_len_out, states,
		(zcbor_decoder_t *)encode_msg, sizeof(states) / sizeof(zcbor_state_t), 1);
}
```

## src/msg_encode.h
```c
/*
 * Generated using zcbor version 0.8.1
 * https://github.com/NordicSemiconductor/zcbor
 * Generated with a --default-max-qty of 256
 */

#ifndef MSG_ENCODE_H__
#define MSG_ENCODE_H__

#include <stdint.h>
#include <stdbool.h>
#include <stddef.h>
#include <string.h>
#include "msg_encode_types.h"

#ifdef __cplusplus
extern "C" {
#endif

#if DEFAULT_MAX_QTY != 256
#error "The type file was generated with a different default_max_qty than this file"
#endif


int cbor_encode_msg(
		uint8_t *payload, size_t payload_len,
		const struct msg *input,
		size_t *payload_len_out);


#ifdef __cplusplus
}
#endif

#endif /* MSG_ENCODE_H__ */
```

## src/msg_encode_types.h
```c
/*
 * Generated using zcbor version 0.8.1
 * https://github.com/NordicSemiconductor/zcbor
 * Generated with a --default-max-qty of 256
 */

#ifndef MSG_ENCODE_TYPES_H__
#define MSG_ENCODE_TYPES_H__

#include <stdint.h>
#include <stdbool.h>
#include <stddef.h>


#ifdef __cplusplus
extern "C" {
#endif

/** Which value for --default-max-qty this file was created with.
 *
 *  The define is used in the other generated file to do a build-time
 *  compatibility check.
 *
 *  See `zcbor --help` for more information about --default-max-qty
 */
#define DEFAULT_MAX_QTY 256

struct msg_xyz {
	int32_t msg_xyz_x;
	int32_t msg_xyz_y;
	int32_t msg_xyz_z;
};

struct msg {
	uint64_t msg_tphg_timestamp;
	int32_t msg_tphg_temp;
	int32_t msg_tphg_press;
	int32_t msg_tphg_hum;
	struct msg_xyz msg_xyz[256];
	size_t msg_xyz_count;
	uint16_t size;
};

#ifdef __cplusplus
}
#endif

#endif /* MSG_ENCODE_TYPES_H__ */
```

## src/networking.c
```c
#include <zephyr/logging/log.h>
#include "networking.h"
#include "shared.h"

LOG_MODULE_REGISTER(NETWORKING,4);

extern bool send_flag;
extern uint8_t msg_index;
extern struct message_payload message[2][PAYLOAD_COUNT];

uint8_t coap_buf[COAP_MSG_MAX_LEN];
static int sock;
static uint16_t con_token;

bool connected = false;
int cid_supported = true;
struct pollfd fds;
struct sockaddr_storage server;

enum {
	STATE_READ,
	STATE_WRITE
} state = STATE_WRITE;


int connect_to_server(void){
    int err = 0;
    err = server_resolve();
	if (err < 0) {
		LOG_ERR("Failed to resolve server name\n");
		return err;
	}
	
	err = client_init();
	if (err < 0) {
		LOG_ERR("Failed to initialize CoAP client\n");
		return err;
	}

    return err;
}

bool check_list(uint16_t x, uint8_t msg_index) {
	bool send = (x & (1u << msg_index) ? true : false);
	return send;
}

uint8_t getmsgCount(uint16_t x) {
    int i = 0;
    for (i = 9; i >= 0; i--){
    	if((x & (1u << i) ? 1 : 0) == 0)
			break;
    }
    return i;
}

void coap_send_fn(struct k_work * work) {
    int err = 0;
    int received = 0;
	uint8_t tries = 0;
	uint8_t t = 0;
	uint8_t LAST_MSG = 9;
	send_flag = false;
	t = (msg_index == 1) ? 0 : 1;
    int64_t next_msg_time = COAP_TIMEOUT;
	union received_msg recv_payload = {0};
	bool reconnected = false;

	for(int i = 0; i < (PAYLOAD_COUNT / 10);) {
		for(uint8_t x = 0; x < (LAST_MSG + 1);) {
			bool msg_type = (x >= LAST_MSG) ? COAP_TYPE_CON : COAP_TYPE_NON_CON;	
			uint8_t index = i*10+x;

			/*  Skip messages, that has arrived to server */
			if (check_list(recv_payload.integer,x)) {
				x++;
				continue;
			}
			LOG_INF("recv: %d i: %d", recv_payload.integer,x);

			err = client_get_send(message[t][index].payload, message[t][index].size, msg_type, index);
			if (err < 0) {
            	LOG_ERR("client_post_send, error code: %d", err);
				if(tries < 3) {
					tries++;
					continue;
				} 
				else {
					LOG_ERR("Failed %d times, restarting device...",tries);
					NVIC_SystemReset();
				}
            }
			err = wait(next_msg_time, msg_type);
			if (err < 0) {
				LOG_ERR("Error in wait function, error code: %d", err);
				if(tries < 3) {
					tries++;
					continue;
				}
				else if(tries == 4 && !reconnected) {
					LOG_ERR("Reconnecting...");
					err = connect_to_server();
					if(err) {
						LOG_ERR("Cannot connect to server. Restarting device");
						NVIC_SystemReset();
					}
					else {
						reconnected = true;
						continue;
					}
				}
				else {
					LOG_ERR("Failed %d times, quitting...",tries);
					NVIC_SystemReset();
				}
			}
			x++;
		}
		received = recv(sock, coap_buf, sizeof(coap_buf),0);
		if (received < 0) {
			LOG_ERR("Socket error %d, quitting...",errno);
			break;			
			}
		if (received == 0)
			LOG_INF("Empty datagram");
		err = client_handle_get_response(coap_buf, received, recv_payload.bytes);
		if (err < 0) {
			if(tries < 3) {
				continue;
			}
			else {
				break;
			}
		}
		LOG_INF("Payload %d", recv_payload.integer);
		/*Everything arrived to server, set to 0*/
		if(recv_payload.integer == 0x3ff) {
			LAST_MSG = 9;
			i++;
			recv_payload.integer = 0;
		}
		//Something went wrong, resend messages in current index
		else {
			if(tries < 3) {
				LAST_MSG = getmsgCount(recv_payload.integer);
				continue;
			}
			else {
				break; 
			}
		}
	}
}

/**@brief Resolves the configured hostname. */
int server_resolve(void) {
	int err;
	struct addrinfo *result;
	struct addrinfo hints = {
		.ai_family = AF_INET,
		.ai_socktype = SOCK_DGRAM
	};
	char ipv4_addr[NET_IPV4_ADDR_LEN];

	err = getaddrinfo(CONFIG_COAP_SERVER_HOSTNAME, NULL, &hints, &result);
	if (err != 0) {
		LOG_ERR("ERROR: getaddrinfo failed %d\n", err);
		return -EIO;
	}

	if (result == NULL) {
		LOG_ERR("ERROR: Address not found\n");
		return -ENOENT;
	}

	/* IPv4 Address. */
	struct sockaddr_in *server4 = ((struct sockaddr_in *)&server);

	server4->sin_addr.s_addr =
		((struct sockaddr_in *)result->ai_addr)->sin_addr.s_addr;
	server4->sin_family = AF_INET;
	server4->sin_port = htons(CONFIG_COAP_SERVER_PORT);

	inet_ntop(AF_INET, &server4->sin_addr.s_addr, ipv4_addr, sizeof(ipv4_addr));
	LOG_INF("IPv4 Address found %s\n", ipv4_addr);

	/* Free the address. */
	freeaddrinfo(result);

	return 0;
}

/**@brief Initialize the CoAP client */
int client_init(void) {
	int err;

	sock = socket(AF_INET, SOCK_DGRAM, IPPROTO_DTLS_1_2);
	if (sock < 0) {
		LOG_ERR("Failed to create CoAP socket: %d.", errno);
		return -errno;
	}

	enum {
		NONE = 0,
		OPTIONAL = 1,
		REQUIRED = 2,
	};

	int verify = REQUIRED;

	err = setsockopt(sock, SOL_TLS, TLS_PEER_VERIFY, &verify, sizeof(verify));
	if(err) {
		LOG_ERR("Failed to setup peer verification, errno %d", errno);
		return -errno;
	}

	int cid_option = TLS_DTLS_CID_SUPPORTED;

	LOG_DBG("Enable connection id");
	err = setsockopt(sock, SOL_TLS, TLS_DTLS_CID, &cid_option, sizeof(cid_option));
	if (!err) {
		cid_supported = true;
	} else if ((err != EOPNOTSUPP) && (err != EINVAL)) {
		LOG_ERR("Error enabling connection ID: %d", -errno);
		cid_supported = false;
	} else {
		LOG_INF("Connection ID not supported by the provided socket");
		cid_supported = false;
	}

	err = setsockopt(sock, SOL_TLS, TLS_HOSTNAME, CONFIG_COAP_SERVER_HOSTNAME, strlen(CONFIG_COAP_SERVER_HOSTNAME));
	if(err) {
		LOG_ERR("Failed to setup TLS hostname (%s), errno %d",
			CONFIG_COAP_SERVER_HOSTNAME, errno);
		return -errno;
	}

	sec_tag_t sec_tag_list[] = { SEC_TAG };
	err = setsockopt(sock, SOL_TLS, TLS_SEC_TAG_LIST, sec_tag_list, sizeof(sec_tag_t) * ARRAY_SIZE(sec_tag_list));
	if(err) {
		LOG_ERR("Failed to setup socket security tag, errno %d", errno);
		return -errno;
	}

	err = connect(sock, (struct sockaddr *)&server, sizeof(struct sockaddr_in));
	if (err < 0) {
		LOG_ERR("Connect failed : %d", errno);
		return -errno;
	}

	fds.fd = sock;
	fds.events = POLLOUT;

	return 0;
}

int client_handle_get_response(uint8_t *buf, int received, uint8_t *pload) {
	int err;
	struct coap_packet reply;
	const uint8_t *payload;
	uint8_t token[8];
	uint16_t payload_len;
	uint16_t token_len;

	err = coap_packet_parse(&reply, buf, received, NULL, 0);
	if(err < 0) {
		LOG_ERR("Malformed response received: %d", err);
		return err;
	}

	token_len = coap_header_get_token(&reply, token);

	if((token_len != sizeof(con_token)) ||
	    (memcmp(&con_token, token, sizeof(con_token)) != 0)) {
		LOG_ERR("Invalid token received: 0x%02x%02x",
		       token[1], token[0]);
		return -1;
	}

	uint8_t response_code = coap_header_get_code(&reply);
	
	if(response_code == COAP_RESPONSE_CODE_CREATED) {
		LOG_INF("Message ok 0x%x", response_code);
		pload[0] = 0xff;
		pload[1] = 0x3;
	}

	else if(response_code == COAP_RESPONSE_CODE_BAD_REQUEST) {
		payload = coap_packet_get_payload(&reply, &payload_len);
		if (payload_len > 0) {
			pload[0] = payload[0];
			pload[1] = payload[1];
		} 	
		else {
			//bad value, resend all
			pload[0] = 0x0;
			pload[1] = 0x4;
		}
		LOG_INF("CoAP response: code: 0x%x, token 0x%02x%02x, Payload: %d,%d",
	    coap_header_get_code(&reply), token[1], token[0], payload[0], payload[1]);
	}

	else {
		LOG_INF("Response code not supported");
		return -1;
	}

	return 0;
}

int client_get_send(uint8_t * payload, uint16_t payloadSize, bool msg_type, uint16_t token) {
	int err;
	struct coap_packet request;

	LOG_INF("State: %d", state);

	if(!msg_type) {
		con_token = token;
	}

	err = coap_packet_init(&request, coap_buf, sizeof(coap_buf),
			       APP_COAP_VERSION, msg_type,
			       sizeof(token), (uint8_t *)&token,
			       COAP_METHOD_POST, coap_next_id());
	if(err < 0) {
		LOG_ERR("Failed to create CoAP request, %d", err);
		return err;
	}

	err = coap_packet_append_option(&request, COAP_OPTION_URI_PATH,
					(uint8_t *)CONFIG_COAP_RESOURCE,
					strlen(CONFIG_COAP_RESOURCE));
	if(err < 0) {
		LOG_ERR("Failed to encode CoAP option, %d", err);
		return err;
	}

	err = coap_packet_append_payload_marker(&request);
		if(err < 0) {
		LOG_ERR("Failed to append CoAP payload marker, %d", err);
		return err;
	}

	err = coap_packet_append_payload(&request, payload,payloadSize);
	if(err < 0) {
		LOG_ERR("Failed to append CoAP payload, %d", err);
		return err;
	}

	err = send(sock, request.data, request.offset, 0);
	if(err < 0) {
		LOG_ERR("Failed to send CoAP request, %d", errno);
		return -errno;
	}

	LOG_INF("CoAP request sent: token 0x%04x", token);

	return 0;
}


int wait(int timeout, bool status) {
	
	fds.events = (!status) ? POLLIN : POLLOUT;
	
	int ret = poll(&fds, 1, timeout);
	if (ret < 0) {
		LOG_ERR("poll error: %d", errno);
		return -errno;
	}

	if (ret == 0) {
		/* Timeout. */
		return -EAGAIN;
	}

	if ((fds.revents & POLLERR) == POLLERR) {
		LOG_ERR("wait: POLLERR");
		return -EIO;
	}

	if ((fds.revents & POLLNVAL) == POLLNVAL) {
		LOG_ERR("wait: POLLNVAL");
		return -EBADF;
	}

	return 0;
}
```

## src/networking.h
```c
#ifndef NETWORKING_H
#define NETWORKING_H

#include <zephyr/net/coap.h>
#include <zephyr/net/socket.h>
#include <zephyr/random/random.h>
#include <zephyr/net/tls_credentials.h>

#define COAP_TIMEOUT 3000
#define COAP_MSG_MAX_LEN 1280
#define APP_COAP_VERSION 1
#define SEC_TAG 123
#define POLL_IN 0
#define POLL_OUT 1

union received_msg {
  uint16_t integer;
  uint8_t bytes[2];
};

int connect_to_server(void);
int wait(int timeout, bool status);
int server_resolve(void);
int client_init(void);
void coap_send_fn(struct k_work * work);
int client_handle_get_response(uint8_t *buf, int received,uint8_t *pload);
int client_get_send(uint8_t * payload, uint16_t payloadSize, bool msg_type, uint16_t token);
bool check_list(uint16_t x, uint8_t msg_index);

#endif //NETWORKING_H
```

## src/sensor.h
```c
#ifndef SENSORS_H
#define SENSORS_H

#include <zcbor_common.h>
#include <zephyr/device.h>
#include <zephyr/drivers/sensor.h>
#include <zephyr/logging/log.h>

#define FIFO_SIZE 510
#define ARRAY_BYTE 1
#define TABLE_BYTES 2

void empty_fifo_fn(struct k_work *work);
uint16_t heatshrink_compression(uint8_t* input_data, uint16_t input_len, uint8_t* output_data);
int cbor_bit_width(long int number);
int cbor_bit_width_timestamp(uint64_t number);
void trigger_handler(const struct device *dev, const struct sensor_trigger *trig);
int initialize_sensors(void);

#endif //SENSORS_H
```

## src/shared.c
```c
#include "shared.h"

bool send_flag;
uint8_t msg_index;
struct message_payload message[2][PAYLOAD_COUNT];
```
